## CMakeLists.txt
```
# SPDX-License-Identifier: Apache-2.0

cmake_minimum_required(VERSION 3.20.0)

find_package(Zephyr REQUIRED HINTS $ENV{ZEPHYR_BASE})
project(app)

FILE(GLOB app_sources 
    main.cpp
    AppContext.cpp
    thread/*.cpp
    peripheral/*.cpp
)
target_sources(app PRIVATE ${app_sources})
```

## sample.yaml
```
sample:
  name: ArduProf Blinky Sample
tests:
  sample.basic.blinky:
    tags:
      - ArduProf
      - LED
    filter: 
    depends_on: 
    harness: led
    integration_platforms:
      - frdm_k64f
```

## prj.conf
```kconfig
CONFIG_CPP=y
CONFIG_REQUIRES_FULL_LIBCPP=y

# CONFIG_DK_LIBRARY=y

CONFIG_LOG=y
# CONFIG_LOG_DEFAULT_LEVEL=2
# CONFIG_LOG_DEFAULT_LEVEL=4
```

## boards/promicro_nrf52840_nrf52840_uf2.overlay
```dts
// #include <zephyr/dt-bindings/pinctrl/nrf-pinctrl.h>
// #include <nordic/nrf52840_qiaa.dtsi>


/ {
	model = "ProMicro nRF52840 UF2";
	compatible = "nordic,nrf52840-dk-nrf52840";

    leds {
		compatible = "gpio-leds";
		led0: led_0 {
			gpios = < &gpio0 15 0x0 >;
			label = "Red LED";
		};
	};

    aliases {
        ledusr = &led0;

    };
};
```

## src/main.cpp
```c
/* Copyright 2024 teamprof.net@gmail.com
 *
 * Permission is hereby granted, free of charge, to any person obtaining a copy of this
 * software and associated documentation files (the "Software"), to deal in the Software
 * without restriction, including without limitation the rights to use, copy, modify,
 * merge, publish, distribute, sublicense, and/or sell copies of the Software, and to
 * permit persons to whom the Software is furnished to do so, subject to the following
 * conditions:
 *
 * The above copyright notice and this permission notice shall be included in all
 * copies or substantial portions of the Software.
 *
 * THE SOFTWARE IS PROVIDED "AS IS", WITHOUT WARRANTY OF ANY KIND, EXPRESS OR IMPLIED,
 * INCLUDING BUT NOT LIMITED TO THE WARRANTIES OF MERCHANTABILITY, FITNESS FOR A
 * PARTICULAR PURPOSE AND NONINFRINGEMENT. IN NO EVENT SHALL THE AUTHORS OR COPYRIGHT
 * HOLDERS BE LIABLE FOR ANY CLAIM, DAMAGES OR OTHER LIABILITY, WHETHER IN AN ACTION
 * OF CONTRACT, TORT OR OTHERWISE, ARISING FROM, OUT OF OR IN CONNECTION WITH THE
 * SOFTWARE OR THE USE OR OTHER DEALINGS IN THE SOFTWARE.
 */
#include <stdbool.h>
#include <zephyr/types.h>
#include <zephyr/kernel.h>
#include <zephyr/logging/log.h>

#include "./app/AppContext.h"
#include "./app/thread/QueueMain.h"

#define LOG_LEVEL 4
LOG_MODULE_REGISTER(main, LOG_LEVEL);

int main(void)
{
	auto queueMain = QueueMain::getInstance();
	AppContext appContext = {
		.queueMain = queueMain,
	};

	queueMain->start(&appContext);
	queueMain->postEvent(EventNull);
	queueMain->messageLoopForever();

	return 0;
}
```
